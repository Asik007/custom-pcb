

/ {
    chosen {
        zmk,kscan = &kscan0;
    };

    kscan0: kscan_0 {
        compatible = "zmk,kscan-gpio-direct";
        wakeup-source;
        input-gpios
            = <&xiao_d 0 (GPIO_INPUT)>
            , <&xiao_d 2 (GPIO_INPUT)>
            , <&xiao_d 4 (GPIO_INPUT)>
            ;
    };
};